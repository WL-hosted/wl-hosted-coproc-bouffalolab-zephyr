## CMakeLists.txt
```
# SPDX-License-Identifier: Apache-2.0
cmake_minimum_required(VERSION 3.20.0)

list(APPEND EXTRA_ZEPHYR_MODULES
    "${CMAKE_CURRENT_SOURCE_DIR}/third_party/CherryUSB")
find_package(Zephyr REQUIRED HINTS $ENV{ZEPHYR_BASE})
project(wlh_coproc_bouffalolab_zephyr LANGUAGES C)

add_subdirectory(main)
```

## Kconfig
```
# SPDX-License-Identifier: Apache-2.0

mainmenu "WL-hosted BL616 coprocessor"

config WLH_WIFI_BACKEND
	bool "Enable the BL616 Wi-Fi backend"
	default y
	select NETWORKING
	select WIFI
	select WIFI_BFLB
	select NET_SOCKETS
	select NET_SOCKETS_PACKET
	help
	  Build and initialize the BL616 Wi-Fi adapter.

config WLH_USB_TRANSPORT
	bool "Enable the CherryUSB transport"
	default y
	select HWINFO
	select CHERRYUSB
	select CHERRYUSB_DEVICE
	help
	  Build and initialize the CherryUSB high-speed bulk transport.

# Keep subsystem tuning attached to the feature which consumes it. These
# declarations precede Zephyr's definitions so their conditional defaults take
# precedence only when the WL-hosted feature is enabled.
config NET_IPV4
	default n if WLH_WIFI_BACKEND

config NET_IPV6
	default n if WLH_WIFI_BACKEND

config NET_MAX_CONTEXTS
	default 8 if WLH_WIFI_BACKEND

config NET_PKT_RX_COUNT
	default 40 if WLH_WIFI_BACKEND

config NET_PKT_TX_COUNT
	default 40 if WLH_WIFI_BACKEND

config NET_BUF_RX_COUNT
	default 80 if WLH_WIFI_BACKEND

config NET_BUF_TX_COUNT
	default 80 if WLH_WIFI_BACKEND

config NET_RX_STACK_SIZE
	default 4096 if WLH_WIFI_BACKEND

config NET_TX_STACK_SIZE
	default 4096 if WLH_WIFI_BACKEND

config NET_MGMT_EVENT_QUEUE_SIZE
	default 32 if WLH_WIFI_BACKEND

config WIFI_BFLB_WIFI6_TX_MAX_PENDING
	default 16 if WLH_WIFI_BACKEND

config WIFI_BFLB_WIFI6_WRAM_HEAP_SIZE
	default 16384 if WLH_WIFI_BACKEND

choice CHERRYUSB_DEVICE_SPEED
	default CHERRYUSB_DEVICE_SPEED_HS if WLH_USB_TRANSPORT
endchoice

choice CHERRYUSB_DEVICE_IP
	default CHERRYUSB_DEVICE_BL if WLH_USB_TRANSPORT
endchoice

source "Kconfig.zephyr"
```

## west.yml
```
manifest:
  version: "1.2"
  remotes:
    - name: zephyrproject-rtos
      url-base: https://github.com/zephyrproject-rtos
  projects:
    - name: zephyr
      remote: zephyrproject-rtos
      revision: 5058917ea61b9d075f24c0dfeb89fdb95a405d52
      import:
        name-allowlist:
          - hal_bouffalolab
          - hostap
          - mbedtls
          - tf-psa-crypto
  self:
    path: app
```

## prj.conf
```kconfig
# SPDX-License-Identifier: Apache-2.0
CONFIG_MAIN_STACK_SIZE=4096
CONFIG_HEAP_MEM_POOL_SIZE=49152
CONFIG_SYSTEM_WORKQUEUE_STACK_SIZE=4096
CONFIG_DYNAMIC_THREAD=y
CONFIG_DYNAMIC_THREAD_ALLOC=y
CONFIG_THREAD_STACK_INFO=y
CONFIG_THREAD_NAME=y
CONFIG_EVENTS=y
CONFIG_DYNAMIC_INTERRUPTS=y
CONFIG_SIZE_OPTIMIZATIONS=y

CONFIG_SERIAL=y
CONFIG_CONSOLE=y
CONFIG_UART_CONSOLE=y
CONFIG_LOG=y
CONFIG_LOG_DEFAULT_LEVEL=3

# Coprocessor feature selection.
CONFIG_WLH_WIFI_BACKEND=y
CONFIG_WLH_USB_TRANSPORT=y
```

## app.overlay
```dts
/* SPDX-License-Identifier: Apache-2.0 */

/*
 * Reserve the final 8 KiB of BL616 OCRAM for USB DMA. The normal Zephyr SRAM
 * mapping starts at the cacheable bus-remap alias (0x62fc0000); CherryUSB uses
 * the matching non-cacheable alias below so VDMA and the CPU remain coherent.
 */
&all_ram {
	reg = <0x62fc0000 DT_SIZE_K(312)>;
	ranges = <0x0 0x62fc0000 DT_SIZE_K(312)>;
};

/ {
	soc {
		usb_nocache: memory@2300e000 {
			compatible = "zephyr,memory-region", "mmio-sram";
			reg = <0x2300e000 DT_SIZE_K(8)>;
			zephyr,memory-region = "USB_NOCACHE";
		};
	};
};
```

## src/main.c
```c
/* SPDX-License-Identifier: Apache-2.0 */
#include <string.h>

#include <zephyr/kernel.h>
#include <zephyr/logging/log.h>

#include "firmware_config.h"
#include "transport.h"
#include "wifi_backend.h"
#include "wlh/coproc.h"
#include "wlh/zephyr_osal.h"

LOG_MODULE_REGISTER(wlh_coproc_app, LOG_LEVEL_INF);

static wlh_coproc_t coproc;
static wlh_zephyr_osal_t zephyr_osal;
static struct k_sem reset_requested;
static struct k_thread link_control_thread;
K_THREAD_STACK_DEFINE(link_control_stack, 2048);

static uint8_t *buffer_alloc(void *context, size_t size) {
  (void)context;
  return k_malloc(size);
}

static void buffer_free(void *context, uint8_t *buffer) {
  (void)context;
  k_free(buffer);
}

static int get_device_info(void *context, wlh_coproc_device_info_t *info) {
  (void)context;
  memset(info, 0, sizeof(*info));
  strncpy(info->vendor, "Bouffalo Lab", sizeof(info->vendor) - 1u);
  strncpy(info->mcu_model, WLH_MCU_NAME, sizeof(info->mcu_model) - 1u);
  strncpy(info->board_profile, WLH_BOARD_PROFILE,
          sizeof(info->board_profile) - 1u);
  return 0;
}

static void on_transport_reset(void *context) {
  (void)context;
  wlh_wifi_backend_transport_dead();
  k_sem_give(&reset_requested);
}

static void link_control_entry(void *first, void *second, void *third) {
  (void)first;
  (void)second;
  (void)third;
  for (;;) {
    k_sem_take(&reset_requested, K_FOREVER);
    k_msleep(100);
    LOG_WRN("USB reset: restarting Core session");
    if (wlh_coproc_stop(&coproc) != WLH_COPROC_OK)
      LOG_WRN("Core stop failed during reset");
    if (wlh_coproc_start(&coproc) != WLH_COPROC_OK) {
      LOG_ERR("Core restart failed");
    } else {
      wlh_wifi_backend_transport_alive();
    }
  }
}

int main(void) {
  wlh_coproc_config_t config;
  wlh_transport_config_t transport_config;

  LOG_INF("wl-hosted %s coprocessor (%s)", WLH_MCU_NAME, WLH_BOARD_PROFILE);
  k_sem_init(&reset_requested, 0u, 1u);
  wlh_zephyr_osal_init(&zephyr_osal);

  memset(&config, 0, sizeof(config));
  config.port.submit_tx = wlh_transport_submit_tx;
  config.port.ethernet_sta_rx = wlh_wifi_backend_ethernet_tx;
  config.port.ethernet_ap_rx = wlh_wifi_backend_ethernet_tx;
  config.buffers = (wlh_coproc_buffer_ops_t){NULL, buffer_alloc, buffer_free};
  config.osal = wlh_zephyr_osal_ops(&zephyr_osal);
  config.wifi = wlh_wifi_backend_ops();
  config.device_info = (wlh_coproc_device_info_ops_t){NULL, get_device_info};
  strncpy(config.implementation_version, WLH_IMPLEMENTATION_VERSION,
          sizeof(config.implementation_version) - 1u);
  config.max_frame_size = wlh_transport_max_frame_size();
  config.heartbeat_interval_ms = 1000u;
  config.initial_credit = wlh_wifi_backend_rx_capacity();
  config.core_queue_depth = WLH_CORE_QUEUE_DEPTH;
  config.ethernet_tx_depth = (uint8_t)wlh_transport_tx_capacity();
  config.ethernet_tx_aggregation_limit = 4u;
  config.stop_timeout_ms = WLH_STOP_TIMEOUT_MS;
  config.core_task = (wlh_osal_task_attributes_t){
      "wlh-core", WLH_CORE_TASK_STACK, WLH_CORE_TASK_OSAL_PRIORITY};

  if (wlh_coproc_init(&coproc, &config) != WLH_COPROC_OK) {
    LOG_ERR("Core initialization failed");
    return -1;
  }
  if (wlh_wifi_backend_init(&coproc) != 0) {
    LOG_ERR("Wi-Fi backend initialization failed");
    return -1;
  }
  if (wlh_coproc_start(&coproc) != WLH_COPROC_OK) {
    LOG_ERR("Core start failed");
    return -1;
  }

  transport_config = (wlh_transport_config_t){&coproc, config.max_frame_size,
                                              on_transport_reset, NULL};
  if (wlh_transport_start(&transport_config) != 0) {
    LOG_ERR("CherryUSB transport start failed");
    return -1;
  }

  k_thread_create(&link_control_thread, link_control_stack,
                  K_THREAD_STACK_SIZEOF(link_control_stack), link_control_entry,
                  NULL, NULL, NULL, K_PRIO_PREEMPT(5), 0, K_NO_WAIT);
  k_thread_name_set(&link_control_thread, "wlh-link-control");
  LOG_INF("coprocessor ready, waiting for USB host");
  return 0;
}
```

## include/bflb_core.h
```c
/* SPDX-License-Identifier: Apache-2.0 */
#ifndef WLH_CHERRYUSB_BFLB_CORE_H
#define WLH_CHERRYUSB_BFLB_CORE_H

#include <stdint.h>

#include <zephyr/irq.h>
#include <zephyr/kernel.h>

/* CherryUSB defines its own utility macro with this name. */
#undef DIV_ROUND_CLOSEST

typedef void (*bflb_irq_handler_t)(int irq, void *argument);

static bflb_irq_handler_t wlh_bflb_irq_handler;
static void *wlh_bflb_irq_argument;

static inline uint32_t getreg32(uintptr_t address) {
  return *(volatile uint32_t *)address;
}

static inline void putreg32(uint32_t value, uintptr_t address) {
  *(volatile uint32_t *)address = value;
}

static inline void bflb_mtimer_delay_us(uint32_t delay_us) {
  k_busy_wait(delay_us);
}

static inline void bflb_mtimer_delay_ms(uint32_t delay_ms) {
  k_msleep(delay_ms);
}

static inline void wlh_bflb_irq_dispatch(const void *unused) {
  (void)unused;
  if (wlh_bflb_irq_handler != NULL)
    wlh_bflb_irq_handler(37, wlh_bflb_irq_argument);
}

static inline int bflb_irq_attach(int irq, bflb_irq_handler_t handler,
                                  void *argument) {
  wlh_bflb_irq_handler = handler;
  wlh_bflb_irq_argument = argument;
  return irq_connect_dynamic((unsigned int)irq, 1u, wlh_bflb_irq_dispatch, NULL,
                             0u);
}

static inline void bflb_irq_enable(int irq) { irq_enable((unsigned int)irq); }

#endif
```

## include/bflb_usb_platform.h
```c
/* SPDX-License-Identifier: Apache-2.0 */
#ifndef WLH_BFLB_USB_PLATFORM_H
#define WLH_BFLB_USB_PLATFORM_H

int wlh_bflb_usb_platform_prepare(void);

#endif /* WLH_BFLB_USB_PLATFORM_H */
```

## include/firmware_config.h
```c
/* SPDX-License-Identifier: Apache-2.0 */
#ifndef WLH_FIRMWARE_CONFIG_H
#define WLH_FIRMWARE_CONFIG_H

#define WLH_MCU_NAME "BL616"
#define WLH_BOARD_PROFILE "bl616-spi-usb/ai_m62_12f_kit"
#define WLH_IMPLEMENTATION_VERSION "0.1.0"

#define WLH_USB_VID 0x303au
#define WLH_USB_PID 0x8201u
#define WLH_USB_MAX_POWER_MA 500u
#define WLH_USB_BUS_ID 0u
#define WLH_USB_EP_OUT 0x01u
#define WLH_USB_EP_IN 0x81u
#define WLH_USB_EP_MPS 512u
#define WLH_USB_RX_RING_SIZE (2u * 4096u + WLH_USB_EP_MPS)
#define WLH_USB_CONTROL_TX_QUEUE_DEPTH 4u
#define WLH_USB_DATA_TX_QUEUE_DEPTH 28u
#define WLH_USB_TX_TIMEOUT_MS 2000u

#define WLH_WIFI_TX_QUEUE_DEPTH 16u
#define WLH_WIFI_MAX_ETHERNET_FRAME_SIZE 1518u
#define WLH_WIFI_SCAN_MAX_RESULTS 24u

#define WLH_CORE_QUEUE_DEPTH 64u
#define WLH_CORE_TASK_STACK 8192u
#define WLH_CORE_TASK_OSAL_PRIORITY 7
#define WLH_INITIAL_CREDIT WLH_WIFI_TX_QUEUE_DEPTH
#define WLH_STOP_TIMEOUT_MS 3000u

#endif
```

## include/transport.h
```c
/* SPDX-License-Identifier: Apache-2.0 */
#ifndef WLH_TRANSPORT_H
#define WLH_TRANSPORT_H

#include <stddef.h>
#include <stdint.h>

#include "wlh/coproc.h"

typedef void (*wlh_transport_reset_fn)(void *context);

typedef struct wlh_transport_config {
  wlh_coproc_t *coproc;
  size_t max_frame_size;
  wlh_transport_reset_fn on_reset;
  void *reset_context;
} wlh_transport_config_t;

int wlh_transport_start(const wlh_transport_config_t *config);
int wlh_transport_submit_tx(void *context, uint8_t *frame, size_t size,
                            wlh_coproc_tx_complete_fn completion,
                            void *completion_context);
size_t wlh_transport_max_frame_size(void);
size_t wlh_transport_tx_capacity(void);

#endif
```

## include/usb_config.h
```c
/* SPDX-License-Identifier: Apache-2.0 */
#ifndef CHERRYUSB_CONFIG_H
#define CHERRYUSB_CONFIG_H

#include <zephyr/kernel.h>
#include <zephyr/sys/printk.h>

#define CONFIG_USB_PRINTF(...) printk(__VA_ARGS__)
#define CONFIG_USB_DBG_LEVEL USB_DBG_INFO
#define CONFIG_USB_ALIGN_SIZE 4
#define USB_NOCACHE_RAM_SECTION __attribute__((section("USB_NOCACHE")))
#define CONFIG_USBDEV_REQUEST_BUFFER_LEN 512
#define CONFIG_USBDEV_MAX_BUS 1
#define CONFIG_USBDEV_EP_NUM 5
#define usb_phyaddr2ramaddr(addr) (addr)
#define usb_ramaddr2phyaddr(addr) (addr)

/* CherryUSB's Bouffalo port uses this legacy macro internally. */
#if defined(CONFIG_CHERRYUSB_DEVICE_SPEED_HS)
#define CONFIG_USB_HS 1
#endif

/* CherryUSB defines its own utility macro with this name. */
#undef DIV_ROUND_CLOSEST

#endif
```

## src/bflb_usb_platform.c
```c
/* SPDX-License-Identifier: Apache-2.0 */
#include "bflb_usb_platform.h"

#include <errno.h>
#include <stdint.h>

#include <zephyr/irq.h>
#include <zephyr/kernel.h>
#include <zephyr/logging/log.h>
#include <zephyr/sys/sys_io.h>

LOG_MODULE_REGISTER(wlh_bflb_usb, LOG_LEVEL_INF);

#define BL616_GLB_BASE 0x20000000u
#define BL616_GLB_SWRST_CFG0_OFFSET 0x540u
#define BL616_GLB_CGEN_CFG2_OFFSET 0x588u
#define BL616_GLB_WIFI_PLL_CFG10_OFFSET 0x838u
#define BL616_GLB_USB_BIT 19u
#define BL616_GLB_USB_MASK (1u << BL616_GLB_USB_BIT)
#define BL616_GLB_USBPLL_RSTB_MASK (1u << 28u)
#define BL616_GLB_PU_USBPLL_MMDIV_MASK (1u << 29u)

int wlh_bflb_usb_platform_prepare(void) {
  const uintptr_t clock_register =
      BL616_GLB_BASE + BL616_GLB_CGEN_CFG2_OFFSET;
  const uintptr_t reset_register =
      BL616_GLB_BASE + BL616_GLB_SWRST_CFG0_OFFSET;
  const uintptr_t pll_register =
      BL616_GLB_BASE + BL616_GLB_WIFI_PLL_CFG10_OFFSET;
  uint32_t clock_after;
  uint32_t pll_after;
  uint32_t reset_value;
  unsigned int key;

  key = irq_lock();

  /* TODO: Remove this explicit gate setup once Zephyr's BL61x clock driver
   * enables GLB_CGEN_CFG2.EXT_USB (bit 19). It currently writes CFG1 bit 13,
   * leaving the controller unclocked and its SFRST bit permanently set. */
  sys_write32(sys_read32(clock_register) | BL616_GLB_USB_MASK,
              clock_register);
  clock_after = sys_read32(clock_register);

  /* Match the official BL616 SDK's GLB_Set_USB_CLK_From_WIFIPLL(1). The
   * Zephyr BL61x clock driver programs USBPLL_SDMIN but does not power and
   * reset the USB PLL divider which supplies the controller's UCLK. */
  sys_write32(sys_read32(pll_register) | BL616_GLB_PU_USBPLL_MMDIV_MASK,
              pll_register);
  k_busy_wait(3u);
  pll_after = sys_read32(pll_register) | BL616_GLB_USBPLL_RSTB_MASK;
  sys_write32(pll_after, pll_register);
  k_busy_wait(2u);
  sys_write32(pll_after & ~BL616_GLB_USBPLL_RSTB_MASK, pll_register);
  k_busy_wait(2u);
  sys_write32(pll_after, pll_register);
  pll_after = sys_read32(pll_register);

  /* Match GLB_AHB_MCU_Software_Reset(GLB_AHB_MCU_SW_EXT_USB): the reset
   * request is active high and must be returned to its inactive state. */
  reset_value = sys_read32(reset_register) & ~BL616_GLB_USB_MASK;
  sys_write32(reset_value, reset_register);
  (void)sys_read32(reset_register);
  sys_write32(reset_value | BL616_GLB_USB_MASK, reset_register);
  (void)sys_read32(reset_register);
  sys_write32(reset_value, reset_register);
  (void)sys_read32(reset_register);

  irq_unlock(key);

  if ((clock_after & BL616_GLB_USB_MASK) == 0u) {
    LOG_ERR("USB clock gate did not latch");
    return -EIO;
  }
  if ((pll_after & (BL616_GLB_PU_USBPLL_MMDIV_MASK |
                    BL616_GLB_USBPLL_RSTB_MASK)) !=
      (BL616_GLB_PU_USBPLL_MMDIV_MASK | BL616_GLB_USBPLL_RSTB_MASK)) {
    LOG_ERR("USB PLL setup did not latch");
    return -EIO;
  }
  return 0;
}
```

## src/transport_usb.c
```c
/* SPDX-License-Identifier: Apache-2.0 */
#include "transport.h"

#include <stdbool.h>
#include <string.h>

#include <zephyr/drivers/hwinfo.h>
#include <zephyr/kernel.h>
#include <zephyr/logging/log.h>
#include <zephyr/sys/atomic.h>
#include <zephyr/sys/ring_buffer.h>

#include "firmware_config.h"
#undef DIV_ROUND_CLOSEST
#include "usbd_core.h"

LOG_MODULE_REGISTER(wlh_usb, LOG_LEVEL_INF);

#define FRAME_HEADER_SIZE 24u
#define FRAME_MAGIC_BYTE0 0x57u
#define FRAME_MAGIC_BYTE1 0x4cu
#define FRAME_PROTOCOL_MAJOR 1u
#define FRAME_FLAGS_MASK 0x03u
#define FRAME_CHANNEL_OFFSET 4u

#define USB_CONFIG_SIZE (9 + 9 + 7 + 7)
#define USB_BASE 0x20072000u
#define USB_CONFIGURED_BIT BIT(0)

typedef struct tx_job {
  uint8_t *frame;
  size_t size;
  wlh_coproc_tx_complete_fn completion;
  void *completion_context;
} tx_job_t;

typedef struct usb_transport {
  wlh_coproc_t *coproc;
  size_t max_frame_size;
  wlh_transport_reset_fn on_reset;
  void *reset_context;
  struct ring_buf rx_ring;
  struct k_msgq tx_control_queue;
  struct k_msgq tx_data_queue;
  struct k_sem tx_done;
  struct k_sem tx_wakeup;
  struct k_sem rx_available;
  struct k_event events;
  struct k_thread tx_thread;
  struct k_thread rx_thread;
  atomic_t stopping;
  atomic_t reset_pending;
  atomic_t out_paused;
  atomic_t initial_configuration_seen;
  uint8_t rx_frame[FRAME_HEADER_SIZE + WLH_COPROC_MAX_FRAME_SIZE];
  size_t rx_frame_length;
} usb_transport_t;

static usb_transport_t transport;
static uint8_t rx_ring_storage[WLH_USB_RX_RING_SIZE];
static uint8_t
    tx_control_storage[WLH_USB_CONTROL_TX_QUEUE_DEPTH * sizeof(tx_job_t)];
static uint8_t tx_data_storage[WLH_USB_DATA_TX_QUEUE_DEPTH * sizeof(tx_job_t)];

K_THREAD_STACK_DEFINE(usb_tx_stack, 3072);
K_THREAD_STACK_DEFINE(usb_rx_stack, 3072);

USB_NOCACHE_RAM_SECTION
__aligned(CONFIG_USB_ALIGN_SIZE) static uint8_t out_chunk[WLH_USB_EP_MPS];
USB_NOCACHE_RAM_SECTION __aligned(CONFIG_USB_ALIGN_SIZE) static uint8_t
    tx_dma_buffer[WLH_COPROC_MAX_FRAME_SIZE];
static uint8_t rx_drain[WLH_USB_EP_MPS];

static char serial_string[17];
static const char langid_string[] = {0x09, 0x04};

extern uint8_t __USB_NOCACHE_start[];
extern uint8_t __USB_NOCACHE_end[];

static const uint8_t device_descriptor[] = {USB_DEVICE_DESCRIPTOR_INIT(
    USB_2_0, 0x00, 0x00, 0x00, WLH_USB_VID, WLH_USB_PID, 0x0100, 0x01)};

static const uint8_t config_descriptor[] = {
    USB_CONFIG_DESCRIPTOR_INIT(USB_CONFIG_SIZE, 0x01, 0x01,
                               USB_CONFIG_BUS_POWERED,
                               WLH_USB_MAX_POWER_MA / 2u),
    USB_INTERFACE_DESCRIPTOR_INIT(0x00, 0x00, 0x02, 0xff, 0x00, 0x00, 0x00),
    USB_ENDPOINT_DESCRIPTOR_INIT(WLH_USB_EP_OUT, USB_ENDPOINT_TYPE_BULK,
                                 WLH_USB_EP_MPS, 0x00),
    USB_ENDPOINT_DESCRIPTOR_INIT(WLH_USB_EP_IN, USB_ENDPOINT_TYPE_BULK,
                                 WLH_USB_EP_MPS, 0x00),
};

static const uint8_t *device_descriptor_callback(uint8_t speed) {
  (void)speed;
  return device_descriptor;
}

static const uint8_t *config_descriptor_callback(uint8_t speed) {
  (void)speed;
  return config_descriptor;
}

static const char *string_descriptor_callback(uint8_t speed, uint8_t index) {
  static const char *strings[] = {
      langid_string,
      "WL-hosted",
      "WL-hosted BL616 Coprocessor",
      serial_string,
  };
  (void)speed;
  return index < ARRAY_SIZE(strings) ? strings[index] : NULL;
}

static const struct usb_descriptor usb_descriptors = {
    .device_descriptor_callback = device_descriptor_callback,
    .config_descriptor_callback = config_descriptor_callback,
    .string_descriptor_callback = string_descriptor_callback,
};

static bool is_control_frame(const uint8_t *frame, size_t size) {
  return frame != NULL && size >= FRAME_HEADER_SIZE &&
         (frame[FRAME_CHANNEL_OFFSET] == WLH_CHANNEL_LINK_CONTROL ||
          frame[FRAME_CHANNEL_OFFSET] == WLH_CHANNEL_CONTROL_RPC);
}

static bool frame_header_plausible(const uint8_t *header) {
  return header[0] == FRAME_MAGIC_BYTE0 && header[1] == FRAME_MAGIC_BYTE1 &&
         header[2] == FRAME_PROTOCOL_MAJOR && header[3] == FRAME_HEADER_SIZE &&
         (header[5] & (uint8_t)~FRAME_FLAGS_MASK) == 0u;
}

static void rx_consume(size_t count) {
  transport.rx_frame_length -= count;
  if (transport.rx_frame_length != 0u) {
    memmove(transport.rx_frame, transport.rx_frame + count,
            transport.rx_frame_length);
  }
}

static void rx_feed(const uint8_t *data, size_t size) {
  if (transport.rx_frame_length + size > sizeof(transport.rx_frame)) {
    LOG_WRN("RX accumulator overflow, resynchronizing");
    transport.rx_frame_length = 0u;
    return;
  }
  memcpy(transport.rx_frame + transport.rx_frame_length, data, size);
  transport.rx_frame_length += size;

  while (transport.rx_frame_length >= FRAME_HEADER_SIZE) {
    size_t frame_size;
    if (!frame_header_plausible(transport.rx_frame)) {
      rx_consume(1u);
      continue;
    }
    frame_size = FRAME_HEADER_SIZE + (size_t)transport.rx_frame[6] +
                 ((size_t)transport.rx_frame[7] << 8);
    if (frame_size > transport.max_frame_size) {
      rx_consume(1u);
      continue;
    }
    if (transport.rx_frame_length < frame_size)
      break;
    if (wlh_coproc_on_frame(transport.coproc, transport.rx_frame, frame_size) !=
        WLH_COPROC_OK) {
      LOG_WRN("RX frame rejected (%u bytes)", (unsigned int)frame_size);
    }
    rx_consume(frame_size);
  }
}

static void arm_out_read(uint8_t busid) {
  if (usbd_ep_start_read(busid, WLH_USB_EP_OUT, out_chunk, sizeof(out_chunk)) !=
      0) {
    LOG_WRN("failed to arm bulk OUT");
  }
}

static void out_endpoint_callback(uint8_t busid, uint8_t ep, uint32_t nbytes) {
  (void)ep;
  if (nbytes != 0u && atomic_get(&transport.stopping) == 0) {
    uint32_t written = ring_buf_put(&transport.rx_ring, out_chunk, nbytes);
    if (written != nbytes) {
      LOG_ERR("RX ring invariant violated");
      atomic_set(&transport.reset_pending, 1);
      k_sem_give(&transport.tx_wakeup);
    } else {
      k_sem_give(&transport.rx_available);
    }
  }
  if (atomic_get(&transport.stopping) == 0 &&
      ring_buf_space_get(&transport.rx_ring) >= WLH_USB_EP_MPS) {
    arm_out_read(busid);
  } else {
    atomic_set(&transport.out_paused, 1);
  }
}

static void in_endpoint_callback(uint8_t busid, uint8_t ep, uint32_t nbytes) {
  (void)busid;
  (void)ep;
  (void)nbytes;
  k_sem_give(&transport.tx_done);
}

static struct usbd_endpoint out_endpoint = {
    .ep_addr = WLH_USB_EP_OUT,
    .ep_cb = out_endpoint_callback,
};
static struct usbd_endpoint in_endpoint = {
    .ep_addr = WLH_USB_EP_IN,
    .ep_cb = in_endpoint_callback,
};
static struct usbd_interface vendor_interface;

static void usb_event_handler(uint8_t busid, uint8_t event) {
  switch (event) {
  case USBD_EVENT_RESET:
    k_event_clear(&transport.events, USB_CONFIGURED_BIT);
    /* The first bus reset is part of normal enumeration and there is no
     * Host session to tear down yet. Every later reset invalidates the
     * negotiated Core session and its outstanding transfers. */
    if (atomic_get(&transport.initial_configuration_seen) != 0)
      atomic_set(&transport.reset_pending, 1);
    atomic_clear(&transport.out_paused);
    k_sem_give(&transport.tx_done);
    k_sem_give(&transport.tx_wakeup);
    break;
  case USBD_EVENT_CONFIGURED:
    if (atomic_cas(&transport.initial_configuration_seen, 0, 1))
      atomic_clear(&transport.reset_pending);
    arm_out_read(busid);
    k_event_post(&transport.events, USB_CONFIGURED_BIT);
    break;
  default:
    break;
  }
}

static void usb_stack_register(void) {
  usbd_desc_register(WLH_USB_BUS_ID, &usb_descriptors);
  usbd_add_interface(WLH_USB_BUS_ID, &vendor_interface);
  usbd_add_endpoint(WLH_USB_BUS_ID, &out_endpoint);
  usbd_add_endpoint(WLH_USB_BUS_ID, &in_endpoint);
}

static void flush_tx_queue(int status) {
  tx_job_t job;
  struct k_msgq *queues[] = {
      &transport.tx_control_queue,
      &transport.tx_data_queue,
  };
  for (size_t index = 0u; index < ARRAY_SIZE(queues); ++index) {
    while (k_msgq_get(queues[index], &job, K_NO_WAIT) == 0) {
      if (job.frame != NULL) {
        job.completion(job.completion_context, job.frame, job.size, status);
      }
    }
  }
}

static void handle_reset(void) {
  if (!atomic_cas(&transport.reset_pending, 1, 0))
    return;
  flush_tx_queue(WLH_COPROC_TX_CANCELLED);
  transport.rx_frame_length = 0u;
  ring_buf_reset(&transport.rx_ring);
  if (transport.on_reset != NULL)
    transport.on_reset(transport.reset_context);
}

int wlh_transport_submit_tx(void *context, uint8_t *frame, size_t size,
                            wlh_coproc_tx_complete_fn completion,
                            void *completion_context) {
  tx_job_t job = {frame, size, completion, completion_context};
  struct k_msgq *queue;
  (void)context;
  if (frame == NULL || completion == NULL || size > sizeof(tx_dma_buffer) ||
      atomic_get(&transport.stopping) != 0)
    return -1;
  queue = is_control_frame(frame, size) ? &transport.tx_control_queue
                                        : &transport.tx_data_queue;
  if (k_msgq_put(queue, &job, K_NO_WAIT) != 0)
    return -1;
  k_sem_give(&transport.tx_wakeup);
  return 0;
}

static bool next_tx_job(tx_job_t *job) {
  return k_msgq_get(&transport.tx_control_queue, job, K_NO_WAIT) == 0 ||
         k_msgq_get(&transport.tx_data_queue, job, K_NO_WAIT) == 0;
}

static void tx_thread_entry(void *first, void *second, void *third) {
  tx_job_t job;
  (void)first;
  (void)second;
  (void)third;
  for (;;) {
    k_sem_take(&transport.tx_wakeup, K_FOREVER);
    handle_reset();
    while (next_tx_job(&job)) {
      int status = 0;
      while ((k_event_wait(&transport.events, USB_CONFIGURED_BIT, false,
                           K_MSEC(100)) &
              USB_CONFIGURED_BIT) == 0u) {
        if (atomic_get(&transport.reset_pending) != 0)
          break;
      }
      if (atomic_get(&transport.reset_pending) != 0) {
        status = WLH_COPROC_TX_CANCELLED;
      } else {
        memcpy(tx_dma_buffer, job.frame, job.size);
        k_sem_reset(&transport.tx_done);
        if (usbd_ep_start_write(WLH_USB_BUS_ID, WLH_USB_EP_IN, tx_dma_buffer,
                                job.size) != 0 ||
            k_sem_take(&transport.tx_done, K_MSEC(WLH_USB_TX_TIMEOUT_MS)) !=
                0 ||
            atomic_get(&transport.reset_pending) != 0) {
          status = WLH_COPROC_TX_CANCELLED;
        }
      }
      job.completion(job.completion_context, job.frame, job.size, status);
      if (status != 0) {
        atomic_set(&transport.reset_pending, 1);
        handle_reset();
        break;
      }
    }
  }
}

static void rx_thread_entry(void *first, void *second, void *third) {
  (void)first;
  (void)second;
  (void)third;
  for (;;) {
    k_sem_take(&transport.rx_available, K_FOREVER);
    for (;;) {
      uint32_t size =
          ring_buf_get(&transport.rx_ring, rx_drain, sizeof(rx_drain));
      if (size == 0u)
        break;
      rx_feed(rx_drain, size);
    }
    if (atomic_cas(&transport.out_paused, 1, 0) &&
        atomic_get(&transport.stopping) == 0 &&
        ring_buf_space_get(&transport.rx_ring) >= WLH_USB_EP_MPS) {
      arm_out_read(WLH_USB_BUS_ID);
    }
  }
}

static void fill_serial_string(void) {
  uint8_t id[8] = {0};
  static const char hex[] = "0123456789abcdef";
  ssize_t count = hwinfo_get_device_id(id, sizeof(id));
  if (count < 0)
    count = 0;
  for (size_t index = 0u; index < sizeof(id); ++index) {
    uint8_t value = index < (size_t)count ? id[index] : 0u;
    serial_string[index * 2u] = hex[value >> 4];
    serial_string[index * 2u + 1u] = hex[value & 0x0fu];
  }
  serial_string[sizeof(serial_string) - 1u] = '\0';
}

int wlh_transport_start(const wlh_transport_config_t *config) {
  if (config == NULL || config->coproc == NULL ||
      config->max_frame_size > WLH_COPROC_MAX_FRAME_SIZE)
    return -1;
  memset(&transport, 0, sizeof(transport));
  transport.coproc = config->coproc;
  transport.max_frame_size = config->max_frame_size;
  transport.on_reset = config->on_reset;
  transport.reset_context = config->reset_context;
  ring_buf_init(&transport.rx_ring, sizeof(rx_ring_storage), rx_ring_storage);
  k_msgq_init(&transport.tx_control_queue, tx_control_storage, sizeof(tx_job_t),
              WLH_USB_CONTROL_TX_QUEUE_DEPTH);
  k_msgq_init(&transport.tx_data_queue, tx_data_storage, sizeof(tx_job_t),
              WLH_USB_DATA_TX_QUEUE_DEPTH);
  k_sem_init(&transport.tx_done, 0u, 1u);
  k_sem_init(&transport.tx_wakeup, 0u, 1u);
  k_sem_init(&transport.rx_available, 0u, 1u);
  k_event_init(&transport.events);
  fill_serial_string();

  /* Devicetree memory regions are NOLOAD. Clear CherryUSB state and DMA
   * buffers before registering descriptors on every cold boot. */
  memset(__USB_NOCACHE_start, 0,
         (size_t)(__USB_NOCACHE_end - __USB_NOCACHE_start));

  k_thread_create(&transport.tx_thread, usb_tx_stack,
                  K_THREAD_STACK_SIZEOF(usb_tx_stack), tx_thread_entry, NULL,
                  NULL, NULL, K_PRIO_PREEMPT(3), 0, K_NO_WAIT);
  k_thread_name_set(&transport.tx_thread, "wlh-usb-tx");
  k_thread_create(&transport.rx_thread, usb_rx_stack,
                  K_THREAD_STACK_SIZEOF(usb_rx_stack), rx_thread_entry, NULL,
                  NULL, NULL, K_PRIO_PREEMPT(3), 0, K_NO_WAIT);
  k_thread_name_set(&transport.rx_thread, "wlh-usb-rx");

  usb_stack_register();
  if (usbd_initialize(WLH_USB_BUS_ID, USB_BASE, usb_event_handler) != 0)
    return -1;
  LOG_INF("CherryUSB ready: %04x:%04x HS bulk", WLH_USB_VID, WLH_USB_PID);
  return 0;
}

size_t wlh_transport_max_frame_size(void) { return WLH_COPROC_MAX_FRAME_SIZE; }

size_t wlh_transport_tx_capacity(void) { return WLH_USB_DATA_TX_QUEUE_DEPTH; }
```

## src/wifi_backend.c
```c
/* SPDX-License-Identifier: Apache-2.0 */
#include "wifi_backend.h"

#include <errno.h>
#include <string.h>

#include <zephyr/kernel.h>
#include <zephyr/logging/log.h>
#include <zephyr/net/ethernet.h>
#include <zephyr/net/net_if.h>
#include <zephyr/net/net_mgmt.h>
#include <zephyr/net/socket.h>
#include <zephyr/net/wifi_mgmt.h>
#include <zephyr/sys/atomic.h>

#include "firmware_config.h"

LOG_MODULE_REGISTER(wlh_wifi, LOG_LEVEL_INF);

#define WLH_WIFI_INTERFACE_STA BIT(0)
#define WLH_WIFI_INTERFACE_AP BIT(1)

#define WLH_WIFI_SECURITY_OPEN 1u
#define WLH_WIFI_SECURITY_WEP 2u
#define WLH_WIFI_SECURITY_WPA_PSK 3u
#define WLH_WIFI_SECURITY_WPA2_PSK 4u
#define WLH_WIFI_SECURITY_WPA_WPA2_PSK 5u
#define WLH_WIFI_SECURITY_WPA3_SAE 6u
#define WLH_WIFI_SECURITY_WPA2_WPA3_PSK 7u

#define WLH_DISCONNECT_REASON_LOCAL_REQUEST 1u
#define WLH_DISCONNECT_REASON_AUTH_FAILED 3u
#define WLH_DISCONNECT_REASON_LINK_LOST 8u

typedef enum wifi_mode {
  WLH_WIFI_MODE_NONE = 0,
  WLH_WIFI_MODE_STA,
  WLH_WIFI_MODE_AP,
} wifi_mode_t;

typedef struct wifi_tx_frame {
  uint32_t session_id;
  uint8_t channel;
  size_t size;
  uint8_t data[WLH_WIFI_MAX_ETHERNET_FRAME_SIZE];
} wifi_tx_frame_t;

typedef struct wifi_backend {
  wlh_coproc_t *coproc;
  struct net_if *iface;
  struct net_mgmt_event_callback event_callback;
  struct k_msgq tx_queue;
  struct k_mutex ingress_lock;
  struct k_thread tx_thread;
  struct k_thread rx_thread;
  int packet_socket;
  uint32_t scan_id;
  uint32_t scan_results;
  atomic_t requested_mode;
  atomic_t active_mode;
  atomic_t connected;
  atomic_t disconnect_locally;
  atomic_t transport_alive;
} wifi_backend_t;

static wifi_backend_t backend;
static uint8_t
    tx_queue_storage[WLH_WIFI_TX_QUEUE_DEPTH * sizeof(wifi_tx_frame_t)];
K_THREAD_STACK_DEFINE(wifi_tx_stack, 3072);
K_THREAD_STACK_DEFINE(wifi_rx_stack, 4096);

static uint32_t map_security_to_wire(enum wifi_security_type security) {
  switch (security) {
  case WIFI_SECURITY_TYPE_NONE:
    return WLH_WIFI_SECURITY_OPEN;
  case WIFI_SECURITY_TYPE_WEP:
  case WIFI_SECURITY_TYPE_WEP_OPEN:
  case WIFI_SECURITY_TYPE_WEP_SHARED:
    return WLH_WIFI_SECURITY_WEP;
  case WIFI_SECURITY_TYPE_WPA_PSK:
    return WLH_WIFI_SECURITY_WPA_PSK;
  case WIFI_SECURITY_TYPE_SAE:
  case WIFI_SECURITY_TYPE_SAE_H2E:
  case WIFI_SECURITY_TYPE_SAE_AUTO:
    return WLH_WIFI_SECURITY_WPA3_SAE;
  case WIFI_SECURITY_TYPE_WPA_AUTO_PERSONAL:
    return WLH_WIFI_SECURITY_WPA_WPA2_PSK;
  default:
    return WLH_WIFI_SECURITY_WPA2_PSK;
  }
}

static int map_security_from_wire(uint32_t security,
                                  enum wifi_security_type *zephyr_security,
                                  enum wifi_mfp_options *mfp) {
  *mfp = WIFI_MFP_DISABLE;
  switch (security) {
  case WLH_WIFI_SECURITY_OPEN:
    *zephyr_security = WIFI_SECURITY_TYPE_NONE;
    return 0;
  case WLH_WIFI_SECURITY_WEP:
    *zephyr_security = WIFI_SECURITY_TYPE_WEP;
    return 0;
  case WLH_WIFI_SECURITY_WPA_PSK:
    *zephyr_security = WIFI_SECURITY_TYPE_WPA_PSK;
    return 0;
  case WLH_WIFI_SECURITY_WPA2_PSK:
    *zephyr_security = WIFI_SECURITY_TYPE_PSK;
    return 0;
  case WLH_WIFI_SECURITY_WPA_WPA2_PSK:
  case WLH_WIFI_SECURITY_WPA2_WPA3_PSK:
    *zephyr_security = WIFI_SECURITY_TYPE_WPA_AUTO_PERSONAL;
    *mfp = WIFI_MFP_OPTIONAL;
    return 0;
  case WLH_WIFI_SECURITY_WPA3_SAE:
    *zephyr_security = WIFI_SECURITY_TYPE_SAE;
    *mfp = WIFI_MFP_REQUIRED;
    return 0;
  default:
    return -EINVAL;
  }
}

static void fill_interface_mac(uint8_t mac[6]) {
  const struct net_linkaddr *address = net_if_get_link_addr(backend.iface);
  if (address != NULL && address->len >= 6u)
    memcpy(mac, address->addr, 6u);
}

static int get_iface_status(struct wifi_iface_status *status) {
  memset(status, 0, sizeof(*status));
  return net_mgmt(NET_REQUEST_WIFI_IFACE_STATUS, backend.iface, status,
                  sizeof(*status));
}

static void report_connected(void) {
  struct wifi_iface_status status;
  wlh_coproc_bss_t bss;
  if (get_iface_status(&status) != 0)
    return;
  memset(&bss, 0, sizeof(bss));
  bss.ssid = (const uint8_t *)status.ssid;
  bss.ssid_size = MIN(status.ssid_len, WIFI_SSID_MAX_LEN);
  memcpy(bss.bssid, status.bssid, sizeof(bss.bssid));
  fill_interface_mac(bss.interface_mac);
  bss.security = map_security_to_wire(status.security);
  bss.channel = status.channel;
  bss.rssi_dbm = status.rssi;
  atomic_set(&backend.connected, 1);
  atomic_set(&backend.active_mode, WLH_WIFI_MODE_STA);
  (void)wlh_coproc_wifi_connected(backend.coproc, &bss);
}

static void report_ap_started(void) {
  struct wifi_iface_status status;
  wlh_coproc_bss_t bss;
  if (get_iface_status(&status) != 0)
    return;
  memset(&bss, 0, sizeof(bss));
  bss.ssid = (const uint8_t *)status.ssid;
  bss.ssid_size = MIN(status.ssid_len, WIFI_SSID_MAX_LEN);
  memcpy(bss.bssid, status.bssid, sizeof(bss.bssid));
  fill_interface_mac(bss.interface_mac);
  bss.security = map_security_to_wire(status.security);
  bss.channel = status.channel;
  atomic_set(&backend.active_mode, WLH_WIFI_MODE_AP);
  (void)wlh_coproc_wifi_ap_started(backend.coproc, &bss);
}

static void wifi_event_handler(struct net_mgmt_event_callback *callback,
                               uint64_t event, struct net_if *iface) {
  (void)iface;
  k_mutex_lock(&backend.ingress_lock, K_FOREVER);
  if (atomic_get(&backend.transport_alive) == 0) {
    k_mutex_unlock(&backend.ingress_lock);
    return;
  }
  switch (event) {
  case NET_EVENT_WIFI_SCAN_RESULT: {
    const struct wifi_scan_result *result =
        (const struct wifi_scan_result *)callback->info;
    wlh_coproc_bss_t bss;
    if (result == NULL || backend.scan_results >= WLH_WIFI_SCAN_MAX_RESULTS)
      break;
    memset(&bss, 0, sizeof(bss));
    bss.ssid = result->ssid;
    bss.ssid_size = result->ssid_length;
    memcpy(bss.bssid, result->mac, sizeof(bss.bssid));
    bss.security = map_security_to_wire(result->security);
    bss.channel = result->channel;
    bss.rssi_dbm = result->rssi;
    (void)wlh_coproc_wifi_scan_result(backend.coproc, backend.scan_id, &bss);
    backend.scan_results++;
    break;
  }
  case NET_EVENT_WIFI_SCAN_DONE:
    (void)wlh_coproc_wifi_scan_completed(backend.coproc, backend.scan_id,
                                         backend.scan_results, false);
    break;
  case NET_EVENT_WIFI_CONNECT_RESULT: {
    const struct wifi_status *status =
        (const struct wifi_status *)callback->info;
    if (status != NULL && status->status == 0)
      report_connected();
    else
      (void)wlh_coproc_wifi_disconnected(
          backend.coproc, WLH_DISCONNECT_REASON_AUTH_FAILED, false);
    break;
  }
  case NET_EVENT_WIFI_DISCONNECT_RESULT:
  case NET_EVENT_WIFI_DISCONNECT_COMPLETE: {
    bool local = atomic_cas(&backend.disconnect_locally, 1, 0);
    atomic_clear(&backend.connected);
    atomic_set(&backend.active_mode, WLH_WIFI_MODE_NONE);
    (void)wlh_coproc_wifi_disconnected(backend.coproc,
                                       local
                                           ? WLH_DISCONNECT_REASON_LOCAL_REQUEST
                                           : WLH_DISCONNECT_REASON_LINK_LOST,
                                       local);
    break;
  }
  case NET_EVENT_WIFI_AP_ENABLE_RESULT: {
    const struct wifi_status *status =
        (const struct wifi_status *)callback->info;
    if (status != NULL && status->status == 0)
      report_ap_started();
    break;
  }
  case NET_EVENT_WIFI_AP_DISABLE_RESULT:
    atomic_set(&backend.active_mode, WLH_WIFI_MODE_NONE);
    (void)wlh_coproc_wifi_ap_stopped(backend.coproc,
                                     WLH_DISCONNECT_REASON_LOCAL_REQUEST, true);
    break;
  case NET_EVENT_WIFI_AP_STA_CONNECTED: {
    const struct wifi_ap_sta_info *station =
        (const struct wifi_ap_sta_info *)callback->info;
    if (station != NULL)
      (void)wlh_coproc_wifi_ap_client_joined(backend.coproc, station->mac, 0,
                                             0u);
    break;
  }
  case NET_EVENT_WIFI_AP_STA_DISCONNECTED: {
    const struct wifi_ap_sta_info *station =
        (const struct wifi_ap_sta_info *)callback->info;
    if (station != NULL)
      (void)wlh_coproc_wifi_ap_client_left(backend.coproc, station->mac, 0u,
                                           0u);
    break;
  }
  default:
    break;
  }
  k_mutex_unlock(&backend.ingress_lock);
}

static int wifi_initialize(void *context, uint32_t operation_id,
                           uint32_t interface_flags) {
  wifi_mode_t requested;
  (void)context;
  if (interface_flags == WLH_WIFI_INTERFACE_STA)
    requested = WLH_WIFI_MODE_STA;
  else if (interface_flags == WLH_WIFI_INTERFACE_AP)
    requested = WLH_WIFI_MODE_AP;
  else
    return -EINVAL;
  atomic_set(&backend.requested_mode, requested);
  return wlh_coproc_wifi_initialized(backend.coproc, operation_id, 0) ==
                 WLH_COPROC_OK
             ? 0
             : -EIO;
}

static int wifi_scan(void *context, uint32_t scan_id) {
  struct wifi_scan_params params = {0};
  (void)context;
  if (atomic_get(&backend.requested_mode) != WLH_WIFI_MODE_STA)
    return -EPERM;
  backend.scan_id = scan_id;
  backend.scan_results = 0u;
  params.scan_type = WIFI_SCAN_TYPE_ACTIVE;
  params.bands = BIT(WIFI_FREQ_BAND_2_4_GHZ);
  params.max_bss_cnt = WLH_WIFI_SCAN_MAX_RESULTS;
  return net_mgmt(NET_REQUEST_WIFI_SCAN, backend.iface, &params,
                  sizeof(params));
}

static int wifi_connect(void *context,
                        const wlh_coproc_wifi_connect_t *request) {
  struct wifi_connect_req_params params;
  (void)context;
  if (request == NULL || request->ssid_size == 0u ||
      request->ssid_size > sizeof(request->ssid) ||
      request->credential_size > sizeof(request->credential) ||
      atomic_get(&backend.requested_mode) != WLH_WIFI_MODE_STA ||
      atomic_get(&backend.active_mode) == WLH_WIFI_MODE_AP)
    return -EINVAL;
  memset(&params, 0, sizeof(params));
  params.ssid = request->ssid;
  params.ssid_length = (uint8_t)request->ssid_size;
  params.psk = request->credential;
  params.psk_length = (uint8_t)request->credential_size;
  params.band = WIFI_FREQ_BAND_2_4_GHZ;
  params.channel = WIFI_CHANNEL_ANY;
  params.timeout = SYS_FOREVER_MS;
  if (map_security_from_wire(request->security, &params.security,
                             &params.mfp) != 0)
    return -EINVAL;
  return net_mgmt(NET_REQUEST_WIFI_CONNECT, backend.iface, &params,
                  sizeof(params));
}

static int wifi_disconnect(void *context) {
  (void)context;
  if (atomic_get(&backend.active_mode) != WLH_WIFI_MODE_STA)
    return -EALREADY;
  atomic_set(&backend.disconnect_locally, 1);
  return net_mgmt(NET_REQUEST_WIFI_DISCONNECT, backend.iface, NULL, 0u);
}

static int wifi_start_ap(void *context, const wlh_coproc_wifi_ap_t *request) {
  struct wifi_connect_req_params params;
  (void)context;
  if (request == NULL || request->ssid_size == 0u ||
      request->ssid_size > sizeof(request->ssid) ||
      request->credential_size > sizeof(request->credential) ||
      atomic_get(&backend.requested_mode) != WLH_WIFI_MODE_AP ||
      atomic_get(&backend.active_mode) == WLH_WIFI_MODE_STA)
    return -EINVAL;
  memset(&params, 0, sizeof(params));
  params.ssid = request->ssid;
  params.ssid_length = (uint8_t)request->ssid_size;
  params.psk = request->credential;
  params.psk_length = (uint8_t)request->credential_size;
  params.band = WIFI_FREQ_BAND_2_4_GHZ;
  params.channel = request->channel == 0u ? 1u : (uint8_t)request->channel;
  if (map_security_from_wire(request->security, &params.security,
                             &params.mfp) != 0)
    return -EINVAL;
  return net_mgmt(NET_REQUEST_WIFI_AP_ENABLE, backend.iface, &params,
                  sizeof(params));
}

static int wifi_stop_ap(void *context) {
  (void)context;
  if (atomic_get(&backend.active_mode) != WLH_WIFI_MODE_AP)
    return -EALREADY;
  return net_mgmt(NET_REQUEST_WIFI_AP_DISABLE, backend.iface, NULL, 0u);
}

static void tx_thread_entry(void *first, void *second, void *third) {
  wifi_tx_frame_t frame;
  struct net_sockaddr_ll destination = {0};
  (void)first;
  (void)second;
  (void)third;
  destination.sll_family = NET_AF_PACKET;
  destination.sll_ifindex = net_if_get_by_iface(backend.iface);
  destination.sll_protocol = net_htons(ETH_P_ALL);
  for (;;) {
    int status;
    k_msgq_get(&backend.tx_queue, &frame, K_FOREVER);
    status = zsock_sendto(backend.packet_socket, frame.data, frame.size, 0,
                          (const struct net_sockaddr *)&destination,
                          sizeof(destination));
    k_mutex_lock(&backend.ingress_lock, K_FOREVER);
    if (atomic_get(&backend.transport_alive) != 0) {
      (void)wlh_coproc_ethernet_rx_complete(
          backend.coproc, frame.session_id, frame.channel, 1u,
          status == (int)frame.size ? 0 : -EIO);
    }
    k_mutex_unlock(&backend.ingress_lock);
  }
}

static void rx_thread_entry(void *first, void *second, void *third) {
  uint8_t frame[WLH_WIFI_MAX_ETHERNET_FRAME_SIZE];
  (void)first;
  (void)second;
  (void)third;
  for (;;) {
    int size = zsock_recv(backend.packet_socket, frame, sizeof(frame), 0);
    if (size <= 0)
      continue;
    k_mutex_lock(&backend.ingress_lock, K_FOREVER);
    if (atomic_get(&backend.transport_alive) != 0 &&
        atomic_get(&backend.active_mode) == WLH_WIFI_MODE_STA &&
        atomic_get(&backend.connected) != 0) {
      (void)wlh_coproc_ethernet_sta_send(backend.coproc, frame, (size_t)size);
    } else if (atomic_get(&backend.transport_alive) != 0 &&
               atomic_get(&backend.active_mode) == WLH_WIFI_MODE_AP) {
      (void)wlh_coproc_ethernet_ap_send(backend.coproc, frame, (size_t)size);
    }
    k_mutex_unlock(&backend.ingress_lock);
  }
}

wlh_coproc_ethernet_rx_result_t
wlh_wifi_backend_ethernet_tx(void *context, uint32_t session_id,
                             uint8_t channel, const uint8_t *frame,
                             size_t size) {
  wifi_tx_frame_t queued;
  (void)context;
  if (frame == NULL || size == 0u || size > sizeof(queued.data) ||
      atomic_get(&backend.active_mode) == WLH_WIFI_MODE_NONE ||
      atomic_get(&backend.transport_alive) == 0)
    return WLH_COPROC_ETHERNET_RX_REJECTED;
  queued.session_id = session_id;
  queued.channel = channel;
  queued.size = size;
  memcpy(queued.data, frame, size);
  return k_msgq_put(&backend.tx_queue, &queued, K_NO_WAIT) == 0
             ? WLH_COPROC_ETHERNET_RX_PENDING
             : WLH_COPROC_ETHERNET_RX_REJECTED;
}

int wlh_wifi_backend_init(wlh_coproc_t *coproc) {
  struct net_sockaddr_ll address = {0};
  uint64_t events =
      NET_EVENT_WIFI_SCAN_RESULT | NET_EVENT_WIFI_SCAN_DONE |
      NET_EVENT_WIFI_CONNECT_RESULT | NET_EVENT_WIFI_DISCONNECT_RESULT |
      NET_EVENT_WIFI_DISCONNECT_COMPLETE | NET_EVENT_WIFI_AP_ENABLE_RESULT |
      NET_EVENT_WIFI_AP_DISABLE_RESULT | NET_EVENT_WIFI_AP_STA_CONNECTED |
      NET_EVENT_WIFI_AP_STA_DISCONNECTED;
  if (coproc == NULL)
    return -EINVAL;
  memset(&backend, 0, sizeof(backend));
  backend.coproc = coproc;
  backend.iface = net_if_get_default();
  if (backend.iface == NULL)
    return -ENODEV;
  k_msgq_init(&backend.tx_queue, tx_queue_storage, sizeof(wifi_tx_frame_t),
              WLH_WIFI_TX_QUEUE_DEPTH);
  k_mutex_init(&backend.ingress_lock);
  atomic_set(&backend.transport_alive, 1);
  net_mgmt_init_event_callback(&backend.event_callback, wifi_event_handler,
                               events);
  net_mgmt_add_event_callback(&backend.event_callback);

  backend.packet_socket =
      zsock_socket(NET_AF_PACKET, NET_SOCK_RAW, net_htons(ETH_P_ALL));
  if (backend.packet_socket < 0)
    return -errno;
  address.sll_family = NET_AF_PACKET;
  address.sll_ifindex = net_if_get_by_iface(backend.iface);
  address.sll_protocol = net_htons(ETH_P_ALL);
  if (zsock_bind(backend.packet_socket, (const struct net_sockaddr *)&address,
                 sizeof(address)) < 0)
    return -errno;

  k_thread_create(&backend.tx_thread, wifi_tx_stack,
                  K_THREAD_STACK_SIZEOF(wifi_tx_stack), tx_thread_entry, NULL,
                  NULL, NULL, K_PRIO_PREEMPT(4), 0, K_NO_WAIT);
  k_thread_name_set(&backend.tx_thread, "wlh-wifi-tx");
  k_thread_create(&backend.rx_thread, wifi_rx_stack,
                  K_THREAD_STACK_SIZEOF(wifi_rx_stack), rx_thread_entry, NULL,
                  NULL, NULL, K_PRIO_PREEMPT(4), 0, K_NO_WAIT);
  k_thread_name_set(&backend.rx_thread, "wlh-wifi-rx");
  return 0;
}

wlh_coproc_wifi_ops_t wlh_wifi_backend_ops(void) {
  return (wlh_coproc_wifi_ops_t){
      NULL,          wifi_initialize, wifi_scan, wifi_connect, wifi_disconnect,
      wifi_start_ap, wifi_stop_ap,
  };
}

uint32_t wlh_wifi_backend_rx_capacity(void) { return WLH_WIFI_TX_QUEUE_DEPTH; }

void wlh_wifi_backend_transport_dead(void) {
  wifi_tx_frame_t frame;
  k_mutex_lock(&backend.ingress_lock, K_FOREVER);
  atomic_clear(&backend.transport_alive);
  while (k_msgq_get(&backend.tx_queue, &frame, K_NO_WAIT) == 0) {
    (void)wlh_coproc_ethernet_rx_complete(backend.coproc, frame.session_id,
                                          frame.channel, 1u,
                                          WLH_COPROC_TX_CANCELLED);
  }
  k_mutex_unlock(&backend.ingress_lock);
}

void wlh_wifi_backend_transport_alive(void) {
  k_mutex_lock(&backend.ingress_lock, K_FOREVER);
  atomic_set(&backend.transport_alive, 1);
  k_mutex_unlock(&backend.ingress_lock);
}
```
